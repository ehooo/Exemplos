/*
  https://github.com/sirleech/Webduino/
  https://github.com/markruys/arduino-DHT

  @author Victor Torre (aka ehooo) https://github.com/ehooo
  Using Webduino library
*/

#include <SPI.h>
#include <Wire.h>
#include <Ethernet.h>
#include "DHT.h"
#include "WebServer.h"
#include "Adafruit_Sensor.h"
#include "Adafruit_BMP085_U.h"

#define DEBUG
#define WEBDUINO_SERIAL_DEBUGGING 0
#define WEBDUINO_FAVICON_DATA { 0x89, 0x50, 0x4E, 0x47, 0x0D, 0x0A, 0x1A, 0x0A, 0x00, 0x00, 0x00, 0x0D, 0x49, 0x48, \\
	0x44, 0x52, 0x00, 0x00, 0x00, 0x10, 0x00, 0x00, 0x00, 0x10, 0x08, 0x06, 0x00, 0x00, 0x00, 0x1F, 0xF3, 0xFF, 0x61, \\
	0x00, 0x00, 0x01, 0x5A, 0x49, 0x44, 0x41, 0x54, 0x38, 0x8D, 0xAD, 0x53, 0x31, 0x4B, 0xC3, 0x40, 0x14, 0xFE, 0xEE, \\
	0x2C, 0xED, 0x5A, 0xC4, 0xA5, 0x1D, 0x92, 0xC9, 0x66, 0x28, 0x05, 0x0B, 0x5D, 0x85, 0x88, 0x83, 0x73, 0xC7, 0x6E, \\
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	0x00, 0x49, 0x45, 0x4E, 0x44, 0xAE, 0x42, 0x60, 0x82 }

static uint8_t mac[] = { 0x02, 0xAA, 0xBB, 0xCC, 0x00, 0x22 };
static uint8_t ip[] = { 192, 168, 0, 51 };

#define DHT_SENSOR_PIN 2
WebServer webserver("",80);
DHT dht;

boolean bmp_on=true;
Adafruit_BMP085_Unified bmp = Adafruit_BMP085_Unified(10085);

float dato;
char buff[8];

void defaultCmd(WebServer &server, WebServer::ConnectionType type, char *, bool){
  if (type == WebServer::POST){
    Serial.println("Redirecting to /");
    server.httpSeeOther("/");
    return;
  }

  server.httpSuccess();
  if (type == WebServer::GET){
    Serial.println("HTML base");
    P(message) = 
"<!DOCTYPE html><html><head>"
  "<title>Meteo Webduino</title>"
  //"<meta http-equiv='Content-Script-Type' content='text/javascript'>"
  "<script src='//code.jquery.com/jquery-2.0.3.js'></script>"
  "<link href='//netdna.bootstrapcdn.com/bootstrap/3.0.3/css/bootstrap.min.css' rel=stylesheet />"
  "<script src='//netdna.bootstrapcdn.com/bootstrap/3.0.3/js/bootstrap.min.js'></script>"
  "<style>  </style>"
  "<script>"
    "function DHT() {"
      "$.getJSON('/dht.json',function(data){"
        "$('#dht_s').text(data.status);"
        "$('#dht_h').text(data.humidity);"
        "$('#dht_t').text(data.temperature);"
      "});"
    "};"
    "function BMP() {"
      "$.getJSON('/bmp.json',function(data){"
        "$('#bmp_p').text(data.pressure);"
        "$('#bmp_t').text(data.temperature);"
        "$('#bmp_a').text(data.altitude);"
      "});"
    "};"
    "function update() {"
      "DHT();"
      "BMP();"
    "};"
    "$(document).ready(function(){ "
      "update();"
      "$('refresh').click(update);"
    "});"
  "</script>"
"</head>"
"<body>"
  "<h2>Sensor data</h2>"
  "<table>"
  "<tr><th>dht status</th><td id='dht_s'></td></tr>"
  "<tr><th>dht humidity </th><td id='dht_h'></td></tr>"
  "<tr><th>dht temperature (C)</th><td id='dht_t'></td></tr>"

  "<tr><th>bmp pressure (hPa)</th><td id='bmp_p'></td></tr>"
  "<tr><th>bmp temperature (C)</th><td id='bmp_t'></td></tr>"
  "<tr><th>bmp altitude (n)</th><td id='bmp_a'></td></tr>"
  "</table>"
  "<button type='button' class='btn btn-primary' id='refresh'>Refrestar</button>"
"</body>"
"</html>";
    server.printP(message);
  }
  Serial.println("Done");
}

void dhtCmd(WebServer &server, WebServer::ConnectionType type, char *, bool){
  server.httpSuccess("application/json");
  if (type == WebServer::GET || type == WebServer::POST){//*
    Serial.println("DHT json");
    server.write("{ \"status\":  \"");
    server.write(dht.getStatusString());

    server.write("\", \"humidity\": ");
    dato = dht.getHumidity();
    dtostrf(dato, 5, 2, buff);
    server.write(buff);
#ifdef DEBUG
    Serial.print("Humidity: ");
    Serial.print(buff);
    Serial.println("");
#endif
    server.write(", \"temperature\": ");
    dato = dht.getTemperature();
    dtostrf(dato, 5, 2, buff);
    server.write(buff);
#ifdef DEBUG
    Serial.print("Temperature: ");
    Serial.print(buff);
    Serial.println(" C");
#endif
    server.write("}");
  }
  Serial.println("Done");
}

void bmpCmd(WebServer &server, WebServer::ConnectionType type, char *, bool){
  Serial.println("BMP json");
  server.httpSuccess("application/json");
  if (type == WebServer::HEAD) return;
  if(!bmp_on){
    server.write("{ \"error\":  \"Sensor BMP085 no detected\"");
  }else{
    sensors_event_t event;
    bmp.getEvent(&event);

    if (event.pressure) {
      server.write("{ \"pressure\":  ");
      dtostrf(event.pressure, 5, 2, buff);
      server.write(buff);
#ifdef DEBUG
      Serial.print("Pressure: ");
      Serial.print(buff);
      Serial.println(" hPa");
#endif

      server.write(", \"temperature\": ");
      bmp.getTemperature(&dato);
      dtostrf(dato, 5, 2, buff);
      server.write(buff);
#ifdef DEBUG
      Serial.print("Temperature: ");
      Serial.print(buff);
      Serial.println(" C");
#endif

      server.write(", \"altitude\": ");
      dato = bmp.pressureToAltitude(SENSORS_PRESSURE_SEALEVELHPA, event.pressure, dato);
      bmp.getTemperature(&dato);
      dtostrf(dato, 5, 2, buff);
      server.write(buff);
      server.write(" }");

#ifdef DEBUG
      Serial.print("Altitude: ");
      Serial.print(buff);
      Serial.println(" m");
#endif
    } else {
      Serial.println("Sensor error");
      server.write("{ \"error\":  \"Sensor BMP085 error\"");
    }
    Serial.println("Done");
  }
}

void setup(){
  Serial.begin(9600);
  while(!Serial){;}

  Serial.println("Iniciando DHT!!");
  dht.setup(DHT_SENSOR_PIN);

  Serial.println("Iniciando BMP085!!");
  if(!bmp.begin()){
    Serial.print("Ooops, no BMP085 detected ... Check your wiring or I2C ADDR!");
    bmp_on = false;
  }

  Serial.println("Iniciando Red!!");
  if( Ethernet.begin(mac) == 0){
    Serial.println("DHCP Error!!");
    Ethernet.begin(mac, ip);
  }
  Serial.print("Server at ");
  Serial.println(Ethernet.localIP());

  webserver.setDefaultCommand(&defaultCmd);
  webserver.addCommand("dht.json", &dhtCmd);
  webserver.addCommand("bmp.json", &bmpCmd);

  webserver.begin();
}

void loop() {
  webserver.processConnection();
}
